# file: SharedRessources.ioc
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FREERTOS.Tasks01=GreenLedTask,24,128,GreenLedTaskStart,Default,NULL,Dynamic,NULL,NULL;RedLedTask,24,128,RedLedTaskStart,Default,NULL,Dynamic,NULL,NULL
Mcu.Family=STM32F4
Mcu.Name=STM32F401R(D-E)Tx
Mcu.Package=LQFP64
NVIC.PriorityGroup=NVIC_PRIORITYGROUP_4
ProjectManager.HeapSize=0x200
ProjectManager.StackSize=0x400
ProjectManager.TargetToolchain=MDK-ARM V5
RCC.AHBFreq_Value=16000000
RCC.APB1Freq_Value=16000000
RCC.APB2Freq_Value=16000000
RCC.CortexFreq_Value=16000000
RCC.HSE_VALUE=25000000
RCC.HSI_VALUE=16000000
RCC.LSE_VALUE=32768
RCC.SYSCLKFreq_VALUE=16000000
RCC.VCOOutputFreq_Value=192000000
VP_FREERTOS_VS_CMSIS_V2.Mode=CMSIS_V2
board=custom

// file: Src/main.c
/* USER CODE BEGIN Header */
/**
  ******************************************************************************
  * @file           : 	.c
  * @brief          : Main program body
  ******************************************************************************
  * @attention
  *
  * <h2><center>&copy; Copyright (c) 2020 STMicroelectronics.
  * All rights reserved.</center></h2>
  *
  * This software component is licensed by ST under Ultimate Liberty license
  * SLA0044, the "License"; You may not use this file except in compliance with
  * the License. You may obtain a copy of the License at:
  *                             www.st.com/SLA0044
  *
  ******************************************************************************
  */
/* USER CODE END Header */

#include "main.h"
#include "cmsis_os.h"

/* USER CODE BEGIN Includes */
#include "freertos.h"
#include "task.h"
#include "semphr.h"

/* USER CODE END Includes */

/* USER CODE BEGIN PD */
#define up 1
#define down 0

/* USER CODE END PD */

/* USER CODE BEGIN PV */
TaskHandle_t RedLedTaskHandle, GreenLedTaskHandle, OrangeLedTaskHandle;
uint32_t GreenLed, RedLed, BlueLed, OrangeLed = 0;
uint32_t sharedDataFlag = up;

SemaphoreHandle_t CriticalResourceSemaphoreHandleHandle;

/* USER CODE END PV */

void SystemClock_Config(void);
void GreenLedTaskStart(void *argument);
void RedLedTaskStart(void *argument);
void OrangeLedTaskStart(void *argument);

int main(void)
{

  /* MCU Configuration--------------------------------------------------------*/

  /* Reset of all peripherals, Initializes the Flash interface and the Systick. */
 // HAL_Init();
	CriticalResourceSemaphoreHandleHandle = xSemaphoreCreateBinary();
	xSemaphoreGive(CriticalResourceSemaphoreHandleHandle);

  /* USER CODE BEGIN Init */
	xTaskCreate(GreenLedTaskStart, "GreenLedFlashTask", 200, NULL, 1, &GreenLedTaskHandle);

	xTaskCreate(RedLedTaskStart, "RedLedFlashTask", 200, NULL, 2, &RedLedTaskHandle);

	xTaskCreate(OrangeLedTaskStart, "OrangeLedFlashTask", 200, NULL, 2, &OrangeLedTaskHandle);

  /* USER CODE END Init */

  /* Configure the system clock */
  //SystemClock_Config();

  /* Initialize all configured peripherals */

  /* Start scheduler */
  vTaskStartScheduler();

  /* We should never get here as control is now taken by the scheduler */

  /* Infinite loop */
  while (1)
  {

  }
}

void SystemClock_Config(void)
{
  RCC_OscInitTypeDef RCC_OscInitStruct = {0};
  RCC_ClkInitTypeDef RCC_ClkInitStruct = {0};

  /** Configure the main internal regulator output voltage
  */
  __HAL_RCC_PWR_CLK_ENABLE();
  __HAL_PWR_VOLTAGESCALING_CONFIG(PWR_REGULATOR_VOLTAGE_SCALE2);
  /** Initializes the CPU, AHB and APB busses clocks
  */
  RCC_OscInitStruct.OscillatorType = RCC_OSCILLATORTYPE_HSI;
  RCC_OscInitStruct.HSIState = RCC_HSI_ON;
  RCC_OscInitStruct.HSICalibrationValue = RCC_HSICALIBRATION_DEFAULT;
  RCC_OscInitStruct.PLL.PLLState = RCC_PLL_NONE;
  if (HAL_RCC_OscConfig(&RCC_OscInitStruct) != HAL_OK)
  {
    Error_Handler();
  }
  /** Initializes the CPU, AHB and APB busses clocks
  */
  RCC_ClkInitStruct.ClockType = RCC_CLOCKTYPE_HCLK|RCC_CLOCKTYPE_SYSCLK
                              |RCC_CLOCKTYPE_PCLK1|RCC_CLOCKTYPE_PCLK2;
  RCC_ClkInitStruct.SYSCLKSource = RCC_SYSCLKSOURCE_HSI;
  RCC_ClkInitStruct.AHBCLKDivider = RCC_SYSCLK_DIV1;
  RCC_ClkInitStruct.APB1CLKDivider = RCC_HCLK_DIV1;
  RCC_ClkInitStruct.APB2CLKDivider = RCC_HCLK_DIV1;

  if (HAL_RCC_ClockConfig(&RCC_ClkInitStruct, FLASH_LATENCY_0) != HAL_OK)
  {
    Error_Handler();
  }
}

void GreenLedTaskStart(void *argument)
{
  /* USER CODE BEGIN 5 */
	uint32_t counter = 0;
	GreenLed = 0;

  /* Infinite loop */
  for(;;)
  {
		GreenLed = 1;
		// simulation access shared data
		//if (up == sharedDataFlag) {
		if (xSemaphoreTake(CriticalResourceSemaphoreHandleHandle, portMAX_DELAY) == pdTRUE){
			//taskENTER_CRITICAL();
			//xSemaphoreTake(CriticalResourceSemaphoreHandleHandle, portMAX_DELAY == pdTRUE);
			// shared data not used by another task
			sharedDataFlag = down;
			while (counter < 1500000) counter++;
			counter = 0;
			sharedDataFlag = up;
			//taskEXIT_CRITICAL();
			xSemaphoreGive(CriticalResourceSemaphoreHandleHandle);
		}
		else {
			// shared data used by another task
			BlueLed = 1;
		}
		vTaskDelay(200);
		GreenLed = 0;
    vTaskDelay(200);
  }
  /* USER CODE END 5 */
}

void RedLedTaskStart(void *argument)
{
 	/* USER CODE BEGIN RedLedTaskStart */
	uint32_t counter = 0;

  /* Infinite loop */
  for(;;)
  {
			RedLed = 1;
    // simulation access shared data
		//if (up == sharedDataFlag) {
		if(xSemaphoreTake(CriticalResourceSemaphoreHandleHandle, portMAX_DELAY) == pdTRUE){
			//taskENTER_CRITICAL();
			//xSemaphoreTake(CriticalResourceSemaphoreHandleHandle, portMAX_DELAY == pdTRUE);
			// shared data not used by another task
			sharedDataFlag = down;
			while (counter < 1500000) counter++;
			counter = 0;
			sharedDataFlag = up;
			//taskEXIT_CRITICAL();
			xSemaphoreGive(CriticalResourceSemaphoreHandleHandle);
		}
		else {
			// shared data used by another task
			BlueLed = 1;
		}
		vTaskDelay(550);
		RedLed = 0;
		vTaskDelay(550);
  }
  /* USER CODE END RedLedTaskStart */
}

void OrangeLedTaskStart(void *argument){
		for(;;){
			OrangeLed^=1;
			vTaskDelay(50);
		}
}

void Error_Handler(void)
{
}

/************************ (C) COPYRIGHT STMicroelectronics *****END OF FILE****/
