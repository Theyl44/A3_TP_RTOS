# file: QueueBasics.ioc
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FREERTOS.Tasks01=defaultTask,0,128,StartDefaultTask,Default,NULL
Mcu.Family=STM32F4
Mcu.Name=STM32F401R(D-E)Tx
Mcu.Package=LQFP64
NVIC.PriorityGroup=NVIC_PRIORITYGROUP_4
ProjectManager.HeapSize=0x200
ProjectManager.StackSize=0x400
ProjectManager.TargetToolchain=MDK-ARM V5.27
RCC.AHBFreq_Value=16000000
RCC.APB1Freq_Value=16000000
RCC.APB2Freq_Value=16000000
RCC.CortexFreq_Value=16000000
RCC.HSE_VALUE=25000000
RCC.HSI_VALUE=16000000
RCC.LSE_VALUE=32768
RCC.SYSCLKFreq_VALUE=16000000
RCC.VCOOutputFreq_Value=192000000
VP_FREERTOS_VS_CMSIS_V1.Mode=CMSIS_V1
board=custom

// file: Src/main.c
/* USER CODE BEGIN Header */
/**
  ******************************************************************************
  * @file           : main.c
  * @brief          : Main program body
  ******************************************************************************
  * @attention
  *
  * <h2><center>&copy; Copyright (c) 2020 STMicroelectronics.
  * All rights reserved.</center></h2>
  *
  * This software component is licensed by ST under Ultimate Liberty license
  * SLA0044, the "License"; You may not use this file except in compliance with
  * the License. You may obtain a copy of the License at:
  *                             www.st.com/SLA0044
  *
  ******************************************************************************
  */
/* USER CODE END Header */

#include "main.h"
#include "cmsis_os.h"

/* USER CODE BEGIN Includes */
#include "freertos.h"
#include "task.h"
#include "stdio.h"
#include "string.h"

/* USER CODE END Includes */

/* USER CODE BEGIN PV */
TaskHandle_t myTask1Handle =  NULL;
TaskHandle_t myTask2Handle =  NULL;

QueueHandle_t myQueue;

/* USER CODE END PV */

//void SystemClock_Config(void);

/* USER CODE BEGIN 0 */

void myTask1(void *p) {
 int count = 1;

	char myTxBuff[30];
	myQueue = xQueueCreate(5, sizeof(myTxBuff));
	sprintf(myTxBuff, "message1");
	xQueueSend(myQueue, (void*) myTxBuff, (TickType_t) 0);

	sprintf(myTxBuff, "message2");
	xQueueSendToFront(myQueue, (void*) myTxBuff, (TickType_t) 0);

	sprintf(myTxBuff, "message3");
	xQueueSend(myQueue, (void*) myTxBuff, (TickType_t) 0);

	printf("data waiting to be read %d:\r\n ", (int) uxQueueMessagesWaiting(myQueue));

	while(1) {
		printf("hello, task1! :%d\r\n", count);
		vTaskDelay(5000);
		sprintf(myTxBuff, "message4");
		xQueueSend(myQueue, (void*) myTxBuff, (TickType_t) 0);
	}
}

void myTask2(void *p) {
	int count = 2;
	char myRxBuff[30];

	while(1) {
		if (myQueue != 0) {
			if (xQueueReceive(myQueue, (void *) myRxBuff, (TickType_t) 5)) {
				int truc = uxQueueMessagesWaiting(myQueue);
				printf("la place : %d \n",truc);
				printf("data received: %s\r\n", myRxBuff);
			}
		}
		printf("hello, task2! :%d\r\n", count);
		vTaskDelay(1000);
	}

}

/* USER CODE END 0 */

int main(void)
{
  /* USER CODE BEGIN 1 */
	xTaskCreate(myTask1, "task1", 200, (void *) 0, tskIDLE_PRIORITY + 1, &myTask1Handle);
	xTaskCreate(myTask2, "task2", 200, (void *) NULL, tskIDLE_PRIORITY + 1, &myTask2Handle);

  /* USER CODE END 1 */

  /* MCU Configuration--------------------------------------------------------*/

  /* Reset of all peripherals, Initializes the Flash interface and the Systick. */

  /* Initialize all configured peripherals */

  /* Create the thread(s) */
  /* definition and creation of defaultTask */

  /* Start scheduler */
	vTaskStartScheduler();

  /* We should never get here as control is now taken by the scheduler */

  /* Infinite loop */
  while (1)
  {

  }
}

void SystemClock_Config(void)
{
  RCC_OscInitTypeDef RCC_OscInitStruct = {0};
  RCC_ClkInitTypeDef RCC_ClkInitStruct = {0};

  /** Configure the main internal regulator output voltage
  */
  __HAL_RCC_PWR_CLK_ENABLE();
  __HAL_PWR_VOLTAGESCALING_CONFIG(PWR_REGULATOR_VOLTAGE_SCALE2);
  /** Initializes the CPU, AHB and APB busses clocks
  */
  RCC_OscInitStruct.OscillatorType = RCC_OSCILLATORTYPE_HSI;
  RCC_OscInitStruct.HSIState = RCC_HSI_ON;
  RCC_OscInitStruct.HSICalibrationValue = RCC_HSICALIBRATION_DEFAULT;
  RCC_OscInitStruct.PLL.PLLState = RCC_PLL_NONE;
  if (HAL_RCC_OscConfig(&RCC_OscInitStruct) != HAL_OK)
  {
    Error_Handler();
  }
  /** Initializes the CPU, AHB and APB busses clocks
  */
  RCC_ClkInitStruct.ClockType = RCC_CLOCKTYPE_HCLK|RCC_CLOCKTYPE_SYSCLK
                              |RCC_CLOCKTYPE_PCLK1|RCC_CLOCKTYPE_PCLK2;
  RCC_ClkInitStruct.SYSCLKSource = RCC_SYSCLKSOURCE_HSI;
  RCC_ClkInitStruct.AHBCLKDivider = RCC_SYSCLK_DIV1;
  RCC_ClkInitStruct.APB1CLKDivider = RCC_HCLK_DIV1;
  RCC_ClkInitStruct.APB2CLKDivider = RCC_HCLK_DIV1;

  if (HAL_RCC_ClockConfig(&RCC_ClkInitStruct, FLASH_LATENCY_0) != HAL_OK)
  {
    Error_Handler();
  }
}

void Error_Handler(void)
{
}

/************************ (C) COPYRIGHT STMicroelectronics *****END OF FILE****/
