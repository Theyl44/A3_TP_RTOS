# file: TD_taches.ioc
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FREERTOS.Tasks01=defaultTask,0,128,StartDefaultTask,Default,NULL,Dynamic,NULL,NULL
Mcu.Family=STM32F4
Mcu.Name=STM32F401R(D-E)Tx
Mcu.Package=LQFP64
NVIC.PriorityGroup=NVIC_PRIORITYGROUP_4
ProjectManager.HeapSize=0x200
ProjectManager.StackSize=0x400
ProjectManager.TargetToolchain=MDK-ARM V5.27
RCC.AHBFreq_Value=16000000
RCC.APB1Freq_Value=16000000
RCC.APB2Freq_Value=16000000
RCC.CortexFreq_Value=16000000
RCC.HSE_VALUE=25000000
RCC.HSI_VALUE=16000000
RCC.LSE_VALUE=32768
RCC.SYSCLKFreq_VALUE=16000000
RCC.VCOOutputFreq_Value=192000000
VP_FREERTOS_VS_CMSIS_V1.Mode=CMSIS_V1
board=custom

// file: Core/Src/main.c
/* USER CODE BEGIN Header */
/**
  ******************************************************************************
  * @file           : main.c
  * @brief          : Main program body
  ******************************************************************************
  * @attention
  *
  * <h2><center>&copy; Copyright (c) 2021 STMicroelectronics.
  * All rights reserved.</center></h2>
  *
  * This software component is licensed by ST under Ultimate Liberty license
  * SLA0044, the "License"; You may not use this file except in compliance with
  * the License. You may obtain a copy of the License at:
  *                             www.st.com/SLA0044
  *
  ******************************************************************************
  */
/* USER CODE END Header */
#include "main.h"

/* USER CODE BEGIN Includes */
#include "stdio.h"
#include "freertos.h"
#include "task.h"

/* USER CODE END Includes */

/* USER CODE BEGIN PV */
TaskHandle_t RedLedFlashTaskHandle, GreenLedFlashTaskHandle;
uint32_t RedLed, GreenLed, BlueLed, OrangeLed;

/* USER CODE END PV */

void RedLedFlashTask(void *argument);
void GreenLedFlashTask(void *argument);

int main(void)
{

  /* MCU Configuration--------------------------------------------------------*/

  /* Reset of all peripherals, Initializes the Flash interface and the Systick. */
  //HAL_Init();

  /* USER CODE BEGIN Init */
	xTaskCreate(GreenLedFlashTask, "GreenLedFlashTask",
								200,
								NULL,
								1,
								&GreenLedFlashTaskHandle);

	xTaskCreate(RedLedFlashTask, "RedLedFlashTask",
								200,
								NULL,
								1,
								&RedLedFlashTaskHandle);

  /* USER CODE END Init */

  /* Configure the system clock */
  //SystemClock_Config();

  /* Initialize all configured peripherals */

  /* Create the thread(s) */
  /* definition and creation of defaultTask */

  /* Start scheduler */
	vTaskStartScheduler();

  /* We should never get here as control is now taken by the scheduler */
  /* Infinite loop */
  while (1)
  {

  }
}

void SystemClock_Config(void)
{
  RCC_OscInitTypeDef RCC_OscInitStruct = {0};
  RCC_ClkInitTypeDef RCC_ClkInitStruct = {0};

  /** Configure the main internal regulator output voltage
  */
  __HAL_RCC_PWR_CLK_ENABLE();
  __HAL_PWR_VOLTAGESCALING_CONFIG(PWR_REGULATOR_VOLTAGE_SCALE2);
  /** Initializes the RCC Oscillators according to the specified parameters
  * in the RCC_OscInitTypeDef structure.
  */
  RCC_OscInitStruct.OscillatorType = RCC_OSCILLATORTYPE_HSI;
  RCC_OscInitStruct.HSIState = RCC_HSI_ON;
  RCC_OscInitStruct.HSICalibrationValue = RCC_HSICALIBRATION_DEFAULT;
  RCC_OscInitStruct.PLL.PLLState = RCC_PLL_NONE;
  if (HAL_RCC_OscConfig(&RCC_OscInitStruct) != HAL_OK)
  {
    Error_Handler();
  }
  /** Initializes the CPU, AHB and APB buses clocks
  */
  RCC_ClkInitStruct.ClockType = RCC_CLOCKTYPE_HCLK|RCC_CLOCKTYPE_SYSCLK
                              |RCC_CLOCKTYPE_PCLK1|RCC_CLOCKTYPE_PCLK2;
  RCC_ClkInitStruct.SYSCLKSource = RCC_SYSCLKSOURCE_HSI;
  RCC_ClkInitStruct.AHBCLKDivider = RCC_SYSCLK_DIV1;
  RCC_ClkInitStruct.APB1CLKDivider = RCC_HCLK_DIV1;
  RCC_ClkInitStruct.APB2CLKDivider = RCC_HCLK_DIV1;

  if (HAL_RCC_ClockConfig(&RCC_ClkInitStruct, FLASH_LATENCY_0) != HAL_OK)
  {
    Error_Handler();
  }
}

/* USER CODE BEGIN 4 */
void RedLedFlashTask(void *argument) {
	uint32_t counter = 0;
	RedLed = (uint32_t) 0;

	TickType_t TaskTimeStamp;
	TickType_t DelayTimeMsec = 1500;

	while(1) {
		OrangeLed = 0x1;
	//	TaskTimeStamp = xTaskGetTickCount();
		RedLed ^= 1;
		// dИlai d'envirion 500ms
		while(counter < 1200000){
			RedLed ^=1;
			counter++;
		}
		counter = 0;
	//	HAL_Delay(500);
		RedLed = 0;
		OrangeLed = 0x0;
		vTaskDelay(DelayTimeMsec);
		//vTaskDelayUntil(&TaskTimeStamp, DelayTimeMsec);
	}

}
void GreenLedFlashTask(void *argument) {

	uint32_t counter = 0;
	GreenLed = (uint32_t) 0;

	TickType_t TaskTimeStamp;
	TickType_t DelayTimeMsec = 6000;
	//vTaskPrioritySet(GreenLedFlashTaskHandle, 0);

	while(1) {
	//	TaskTimeStamp = xTaskGetTickCount();
		BlueLed = 0x1;
		GreenLed ^= 1;
		// dИlai d'envirion 4000ms
		//HAL_Delay(4000);
		while(counter < 9600000){
			GreenLed ^=1;
			counter++;
		}
		counter = 0;
		BlueLed = 0x0;
		GreenLed =0;
		vTaskDelay(DelayTimeMsec);
	//	vTaskDelayUntil(&TaskTimeStamp, DelayTimeMsec);
	}

}

/* USER CODE END 4 */

void Error_Handler(void)
{
  __disable_irq();
  while (1)
  {
  }
}

/************************ (C) COPYRIGHT STMicroelectronics *****END OF FILE****/
